## config/boards/shields/void/Kconfig.defconfig
```kconfig
if SHIELD_VOID_ERGO_LEFT

config ZMK_KEYBOARD_NAME
    default "Void Ergo"

config ZMK_SPLIT_ROLE_CENTRAL
    default y

endif

if SHIELD_void_ergo_LEFT || SHIELD_void_ergo_RIGHT

config ZMK_SPLIT
    default y

if LVGL

config LV_Z_VDB_SIZE
    default 64

config LV_DPI_DEF
    default 148

config LV_Z_BITS_PER_PIXEL
    default 1

choice LV_COLOR_DEPTH
    default LV_COLOR_DEPTH_1
endchoice

endif # LVGL

endif
```

## config/boards/shields/void/Kconfig.shield
```kconfig
# Copyright (c) 2024 Rend
# SPDX-License-Identifier: MIT

config SHIELD_VOID_LEFT
    def_bool $(shields_list_contains,void_left)

config SHIELD_VOID_RIGHT
    def_bool $(shields_list_contains,void_right)
```
